// SPDX-License-Identifier: GPL-2.0+ OR MIT
/*
 * Device tree for the Apollo QVP U-Boot platform model
 *
 * Copyright 2022, 2026 Arm Ltd.
 */

/dts-v1/;

/ {
	model = "Apollo QVP";
	compatible = "arm,apollo-qvp", "arm,vexpress";
};
