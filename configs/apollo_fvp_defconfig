## configs/apollo_fvp_defconfig
```kconfig
CONFIG_ARM=y
# CONFIG_ARM64_CRC32 is not set
CONFIG_ARCH_VEXPRESS64=y
CONFIG_SYS_MALLOC_LEN=0x8E0000
CONFIG_DEFAULT_DEVICE_TREE="apollo-fvp"
CONFIG_IDENT_STRING=" apollo_fvp"
CONFIG_APOLLO_FVP_FW_IMAGES=y
CONFIG_FWU_NUM_IMAGES_PER_BANK=5
CONFIG_EFI_SECURE_BOOT=y
CONFIG_EFI_MM_COMM_TEE=y
CONFIG_FFA_SHARED_MM_BUF_SIZE=8192
CONFIG_FFA_SHARED_MM_BUF_OFFSET=0
CONFIG_FFA_SHARED_MM_BUF_ADDR=0xffbf0000
CONFIG_EFI_VAR_BUF_SIZE=65536
CONFIG_EFI_RUNTIME_UPDATE_CAPSULE=y
CONFIG_EFI_CAPSULE_ON_DISK=y
CONFIG_EFI_CAPSULE_FIRMWARE_RAW=y
CONFIG_EFI_CAPSULE_AUTHENTICATE=y
CONFIG_FIT=y
CONFIG_FIT_SIGNATURE=y
CONFIG_BOOTSTD_DEFAULTS=y
CONFIG_BOOTCOMMAND="virtio scan; if aanxbootselect; then echo auto-ad-nexios: loading ${aanx_uki} from virtio 0:${aanx_boot_part}; if load virtio 0:${aanx_boot_part} ${loadaddr} ${aanx_uki}; then bootefi ${loadaddr}; else echo auto-ad-nexios: missing selected UKI ${aanx_uki}, trying fallback ${aanx_fallback_uki}; if load virtio 0:${aanx_fallback_boot_part} ${loadaddr} ${aanx_fallback_uki}; then bootefi ${loadaddr}; fi; fi; fi; bootflow scan"
# CONFIG_DISPLAY_CPUINFO is not set
CONFIG_CMD_NVEDIT_EFI=y
CONFIG_CMD_AUTO_AD_NEXIOS_BOOTSELECT=y
CONFIG_CMD_EFIDEBUG=y
CONFIG_ARM_FFA_TRANSPORT=y
# CONFIG_RNG_SMCCC_TRNG is not set
CONFIG_TEE=y
CONFIG_OPTEE=y
# CONFIG_HEXDUMP is not set
# CONFIG_OPTEE_LIB is not set
CONFIG_FWU_MULTI_BANK_UPDATE=y
CONFIG_FWU_ARM_PSA=y
# CONFIG_FWU_KEEP_FMP_HEADER is not set
# CONFIG_TOOLS_MKFWUMDATA is not set
```

## lib/fwu_updates/Kconfig
```kconfig
menuconfig FWU_MULTI_BANK_UPDATE
	bool "Enable FWU Multi Bank Update Feature"
	depends on EFI_CAPSULE_ON_DISK
	select PARTITION_TYPE_GUID
	select FWU_MDATA
	imply EFI_CAPSULE_ON_DISK_EARLY
	select EVENT
	help
	  Feature for updating firmware images on platforms having
	  multiple banks(copies) of the firmware images. One of the
	  bank is selected for updating all the firmware components

if FWU_MULTI_BANK_UPDATE

config FWU_NUM_BANKS
	int "Number of Banks defined by the platform"
	help
	  Define the number of banks of firmware images on a platform

config FWU_NUM_IMAGES_PER_BANK
	int "Number of firmware images per bank"
	help
	  Define the number of firmware images per bank. This value
	  should be the same for all the banks.

config FWU_TRIAL_STATE_CNT
	int "Number of times system boots in Trial State"
	default 3
	help
	  With FWU Multi Bank Update feature enabled, number of times
	  the platform is allowed to boot in Trial State after an
	  update.

config FWU_MDATA_V1
	bool "Enable support FWU Metadata version 1"
	help
	  The FWU specification supports two versions of the
	  metadata structure. This option enables support for FWU
	  Metadata version 1 access.

config FWU_MDATA_V2
	bool "Enable support FWU Metadata version 2"
	depends on !FWU_MDATA_V1
	help
	  The FWU specification supports two versions of the
	  metadata structure. This option enables support for FWU
	  Metadata version 2 access.

config FWU_ARM_PSA
	bool "FMP driver for Arm PSA FWU specification"
	depends on EFI_CAPSULE_FIRMWARE_MANAGEMENT && \
		EFI_CAPSULE_FIRMWARE_RAW && \
		ARM_FFA_TRANSPORT && (ARM64 || SANDBOX)
	select EFI_CAPSULE_FIRMWARE
	help
	  Select this option if you want to enable firmware management protocol
	  driver that supports the Arm PSA firmware update specification as
	  mentioned in https://developer.arm.com/documentation/den0118/a/

config FWU_KEEP_FMP_HEADER
	bool "Allow sending the FMP header with the payload"
	depends on FWU_ARM_PSA
	default y
	help
	  Select this option if you do not want to strip the FMP header
	  of the payload

config FWU_ARM_PSA_ACCEPT_IMAGES
	bool "Accept images at EFI ExitBootServices() level"
	depends on FWU_ARM_PSA
	default y
	help
	  Select this option if reaching ExitBootServices() level means the boot succeeded
	  This option will add a callback at ExitBootServices() that accepts all the images.

config FWU_BUFFER_PAGES
	int "Number of 4KB pages in the FWU shared buffer"
	depends on FWU_ARM_PSA
	default 1024
	help
	  This defines the size of the FWU shared buffer used for communication.

endif
```
